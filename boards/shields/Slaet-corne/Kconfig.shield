## boards/shields/Slaet-corne/Kconfig.shield
```kconfig
config SHIELD_OKSLAET_LEFT
    def_bool $(shields_list_contains,okslaet_left)

config SHIELD_OKSLAET_RIGHT
    def_bool $(shields_list_contains,okslaet_right)
```

## config/boards/shields/okslaet/Kconfig.defconfig
```kconfig
if SHIELD_OKSLAET_LEFT

config ZMK_KEYBOARD_NAME
    default "OKSLAET"

config ZMK_SPLIT_ROLE_CENTRAL
    default y

endif

if SHIELD_OKSLAET_LEFT || SHIELD_OKSLAET_RIGHT

config ZMK_SPLIT
    default y

endif
```

## config/boards/shields/slaet_handwire/Kconfig.defconfig
```kconfig
if SHIELD_SLAET_HANDWIRE_LEFT

config ZMK_KEYBOARD_NAME
    default "Slaet-Handwire"

config ZMK_SPLIT_ROLE_CENTRAL
    default y

endif

if SHIELD_SLAET_HANDWIRE_LEFT || SHIELD_SLAET_HANDWIRE_RIGHT

config ZMK_SPLIT
    default y

endif
```

## config/boards/shields/slaet_handwire/Kconfig.shield
```kconfig
config SHIELD_SLAET_HANDWIRE_LEFT
    def_bool $(shields_list_contains,slaet_handwire_left)

config SHIELD_SlaetHandwire_right
    def_bool $(shields_list_contains,slaet_handwire_right)
```
